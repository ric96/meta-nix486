## conf/layer.conf
```bitbake
# We have a conf and classes directory, add to BBPATH
BBPATH .= ":${LAYERDIR}"

# We have recipes-* directories, add to BBFILES
BBFILES += "${LAYERDIR}/recipes-*/*/*.bb \
            ${LAYERDIR}/recipes-*/*/*.bbappend"

BBFILE_COLLECTIONS += "meta-nix486"
BBFILE_PATTERN_meta-nix486 = "^${LAYERDIR}/"
BBFILE_PRIORITY_meta-nix486 = "6"

LAYERDEPENDS_meta-nix486 = "core"
LAYERSERIES_COMPAT_meta-nix486 = "warrior zeus"
```

## conf/machine/generic486.conf
```bitbake
#@TYPE: Machine
#@NAME: generic686
#@DESCRIPTION: Machine configuration for generic x86 (32-bit) PCs. Supports a moderately wide range of drivers that should boot and be usable on "typical" hardware.

DEFAULTTUNE ?= "i486"
require conf/machine/include/i486.inc
require conf/machine/include/qemu.inc
require conf/machine/include/qemuboot-486.inc

UBOOT_MACHINE ?= "qemu-x86_defconfig"

KERNEL_IMAGETYPE = "bzImage"

SERIAL_CONSOLES ?= "115200;ttyS0 115200;ttyS1"

MACHINE_FEATURES += "x86 pci"

MACHINE_ESSENTIAL_EXTRA_RDEPENDS += "v86d"

MACHINE_EXTRA_RRECOMMENDS = "kernel-module-snd-ens1370 kernel-module-snd-rawmidi"

IMAGE_FSTYPES ?= "wic"

WKS_FILE ?= "qemux86-directdisk.wks"
do_image_wic[depends] += "syslinux:do_populate_sysroot syslinux-native:do_populate_sysroot mtools-native:do_populate_sysroot dosfstools-native:do_populate_sysroot"


#MACHINE_ESSENTIAL_EXTRA_RRECOMMENDS += "gma500-gfx-check"
#For runqemu
QB_SYSTEM_NAME = "qemu-system-i386"
```

## conf/machine/include/i486.inc
```bitbake
DEFAULTTUNE ?= "i486"

require conf/machine/include/x86/arch-x86.inc

# Extra tune features
TUNEVALID[i486] = "Enable i486 specific processor optimizations"
TUNE_CCARGS .= "${@bb.utils.contains('TUNE_FEATURES', 'i486', ' -march=i486', '', d)}"
TUNE_PKGARCH_TMP = "${@bb.utils.contains('TUNE_FEATURES', 'm32', 'x86', '', d)}"
TUNE_PKGARCH ?= "${@bb.utils.contains('TUNE_FEATURES', 'i486', 'i486', TUNE_PKGARCH_TMP, d)}"

PREFERRED_PROVIDER_virtual/kernel ?= "linux-yocto"



# Extra tune selections
AVAILTUNES += "i486"
TUNE_FEATURES_tune-i486 = "${TUNE_FEATURES_tune-x86} i486"
BASE_LIB_tune-i486 = "lib"
TUNE_PKGARCH_tune-i486 = "i486"
PACKAGE_EXTRA_ARCHS_tune-i486 = "${PACKAGE_EXTRA_ARCHS_tune-x86} i486"
```

## conf/machine/include/qemu.inc
```bitbake
MACHINE_FEATURES = "alsa bluetooth usbgadget screen vfat"

MACHINEOVERRIDES =. "qemuall:"

IMAGE_FSTYPES += "tar.bz2 ext4"

# Don't include kernels in standard images
RDEPENDS_${KERNEL_PACKAGE_NAME}-base = ""

EXTRA_IMAGEDEPENDS += "qemu-native qemu-helper-native"

# Provide the nfs server kernel module for all qemu images
KERNEL_FEATURES_append_pn-linux-yocto = " features/nfsd/nfsd-enable.scc"
KERNEL_FEATURES_append_pn-linux-yocto-rt = " features/nfsd/nfsd-enable.scc"

IMAGE_CLASSES += "qemuboot"
```

## conf/machine/include/x86/arch-x86.inc
```bitbake
#
# X86 Architecture definition (IA32, X86_64, and X32)
#

DEFAULTTUNE ?= "x86"
TARGET_FPU ?= ""
X86ARCH32 ?= "i486"

TUNE_PKGARCH = "${TUNE_PKGARCH_tune-${DEFAULTTUNE}}"

# ELF32 ABI
TUNEVALID[m32] = "IA32 ELF32 standard ABI"
TUNECONFLICTS[m32] = "m64 mx32"
TUNE_ARCH .= "${@bb.utils.contains('TUNE_FEATURES', 'm32', '${X86ARCH32}', '' ,d)}"
TUNE_CCARGS .= "${@bb.utils.contains('TUNE_FEATURES', 'm32', ' -m32', '', d)}"
MACHINEOVERRIDES =. "${@bb.utils.contains('TUNE_FEATURES', 'm32', 'x86:', '' ,d)}"

# Default Tune configurations
AVAILTUNES += "x86"
TUNE_FEATURES_tune-x86 = "m32"
BASE_LIB_tune-x86 = "lib"
TUNE_PKGARCH_tune-x86 = "x86"
PACKAGE_EXTRA_ARCHS_tune-x86 = "${TUNE_PKGARCH_tune-x86}"
```
